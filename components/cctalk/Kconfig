## components/cctalk/Kconfig
```kconfig
menu "ccTalk"

config CCTALK_UART
	int "UART used to talk to ccTalk devices"
	default 2
	range 0 2
	help
		Select the UART number that should be used when communicating with ccTalk devices
    
endmenu
```

## components/m20ly02z/Kconfig
```kconfig
menu "M20LY02Z"

	choice M20LY02Z_IFACE
		prompt "Interface type"
		config M20LY02Z_IFACE_SERIAL
			bool "M20LY02Z [Serial]"			
		config M20LY02Z_IFACE_PARALLEL
			bool "M20LY02Z [Parallel]"			
	endchoice

endmenu
```
